## config/west.yml
```yaml
manifest:
  remotes:
    - name: zmkfirmware
      url-base: https://github.com/zmkfirmware
    - name: a741725193
      url-base: https://github.com/a741725193
    - name: cormoran
      url-base: https://github.com/cormoran
    - name: urob
      url-base: https://github.com/urob
  projects:
    - name: zmk
      remote: zmkfirmware
      revision: v0.3
      import: app/west.yml
    - name: eyelash_sofle
      remote: a741725193
      revision: main
    - name: zmk-behavior-runtime-sensor-rotate
      remote: cormoran
      revision: main
    - name: zmk-module-ble-management
      remote: cormoran
      revision: zmk-v0.3.0.0
    - name: zmk-module-battery-history
      remote: cormoran
      revision: main
    - name: zmk-module-settings-rpc
      remote: cormoran
      revision: main
    - name: zmk-module-runtime-input-processor
      remote: cormoran
      revision: zmk-v0.3.0.0
    - name: zmk-auto-layer
      remote: urob
      revision: v0.3
  self:
    path: config
```
